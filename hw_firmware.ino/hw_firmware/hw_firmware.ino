// Display
#include <Wire.h>
#include <Adafruit_GFX.h>
#include <Adafruit_SSD1306.h>

// BLE
#include <BLEDevice.h>
#include <BLEUtils.h>
#include <BLEServer.h>

#define SCREEN_WIDTH 128 // OLED display width, in pixels
#define SCREEN_HEIGHT 64 // OLED display height, in pixels

// Declaration for an SSD1306 display connected to I2C (SDA, SCL pins)
// The pins for I2C are defined by the Wire-library.
// On an arduino UNO:       A4(SDA), A5(SCL)
// On an arduino MEGA 2560: 20(SDA), 21(SCL)
// On an arduino LEONARDO:   2(SDA),  3(SCL), ...
#define OLED_RESET -1       // Reset pin # (or -1 if sharing Arduino reset pin)
#define SCREEN_ADDRESS 0x3C ///< See datasheet for Address; 0x3D for 128x64, 0x3C for 128x32
Adafruit_SSD1306 display(SCREEN_WIDTH, SCREEN_HEIGHT, &Wire, OLED_RESET);

#define SERVICE_UUID "d61011ce-6326-4738-a61c-18954ed6c5bd"
#define CHARACTERISTIC_UUID "c479a5fa-7e0f-4fb2-a94e-93dbfe8661af"

volatile bool connected = false;
volatile bool hasText = false;
volatile bool dim = false;
char *payload = new char[256];

static const unsigned char PROGMEM logo_bmp[] = {
    0x0, 0x0, 0x0, 0x0, 0x0, 0x0, 0x0, 0x0, 0x0, 0x0, 0x0, 0x0, 0x0, 0x0, 0x0, 0x0,
    0x0, 0x0, 0x0, 0x0, 0x0, 0x0, 0x0, 0x0, 0x0, 0x0, 0x0, 0x0, 0x0, 0x0, 0x0, 0x0,
    0x0, 0x0, 0x0, 0x0, 0x0, 0x0, 0x0, 0x0, 0x0, 0x0, 0x0, 0x0, 0x0, 0x0, 0x0, 0x0,
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    0x0, 0x0, 0x0, 0x0, 0x0, 0x0, 0x0, 0x0, 0x0, 0x0, 0x0, 0x0, 0x0, 0x0, 0x0, 0x0};

/**
 * Callback to handle Notification characteristic events
 */
class GenericCallback : public BLECharacteristicCallbacks
{

  void onWrite(BLECharacteristic *pCharacteristic)
  {
    connected = true;
    std::string str = pCharacteristic->getValue();
    BLEUUID uuid = pCharacteristic->getUUID();
    std::string uuid_s = uuid.toString();
    Serial.println(str.length());
    Serial.println(str.c_str());
    memset(payload, '\0', sizeof(payload));
    strcpy(payload, str.c_str());
    dim = !dim;
  }
};

void setup()
{
  Serial.begin(115200);
  memset(payload, 0x00, 256);
  BLEDevice::init("Reflex Add-On");
  BLEServer *pServer = BLEDevice::createServer();
  BLEService *pService = pServer->createService(SERVICE_UUID);
  BLECharacteristic *pCharacteristic = pService->createCharacteristic(
      CHARACTERISTIC_UUID,
      BLECharacteristic::PROPERTY_WRITE_NR);
  pCharacteristic->setCallbacks(new GenericCallback());
  pService->start();

  BLEAdvertising *pAdvertising = pServer->getAdvertising();
  pAdvertising->setAppearance(448);
  pAdvertising->start();

  Wire.begin(5, 4);
  // SSD1306_SWITCHCAPVCC = generate display voltage from 3.3V internally
  if (!display.begin(SSD1306_SWITCHCAPVCC, SCREEN_ADDRESS, false, false))
  {
    Serial.println(F("SSD1306 allocation failed"));
    for (;;)
      ; // Don't proceed, loop forever
  }

  display.clearDisplay();

  display.drawBitmap(
      0, 15, logo_bmp, 128, 34, 1);
  display.display();
}

void testdrawchar(void)
{
  display.clearDisplay();

  // display.setTextSize(1);      // Normal 1:1 pixel scale
  display.setCursor(1, 1);             // Start at top-left corner
  display.setTextColor(SSD1306_WHITE); // Draw white text
  display.println(payload);
  // display.setFont(&TomThumb);

  // display.drawBitmap(0, 15, logo_bmp, 128, 34, 1);

  display.invertDisplay(true);
  display.display();
}

void loop()
{
  // put your main code here, to run repeatedly:
  if (connected)
  {
    testdrawchar();
  }

  delay(500); // 500ms
}
